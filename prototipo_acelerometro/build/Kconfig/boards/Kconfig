## prototipo_acelerometro/build/Kconfig/boards/Kconfig
```kconfig
# Load Zephyr board Kconfig descriptions.
osource "C:/Users/javie/zephyrproject/zephyr/boards/st/nucleo_wl55jc/Kconfig"
```

## prototipo_acelerometro/build/Kconfig/boards/Kconfig.defconfig
```kconfig
# Load Zephyr board defconfig descriptions.
osource "C:/Users/javie/zephyrproject/zephyr/boards/st/nucleo_wl55jc/Kconfig.defconfig"
```

## prototipo_acelerometro/build/Kconfig/boards/Kconfig.sysbuild
```kconfig
# Load Sysbuild board Kconfig descriptions.
osource "C:/Users/javie/zephyrproject/zephyr/boards/st/nucleo_wl55jc/Kconfig.sysbuild"
```
